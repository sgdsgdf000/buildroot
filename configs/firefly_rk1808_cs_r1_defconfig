## configs/firefly_rk1808_cs_r1_defconfig
```kconfig
#include "rk1808_arm64.config"
#include "base.config"
#include "base_extra.config"
#include "debug.config"
#include "network.config"
#include "video_mpp.config"
#include "display.config"
#include "video_mpp.config"
#include "video_gst.config"
#include "video_gst_rtsp.config"
#include "qt.config"
BR2_ROOTFS_OVERLAY="board/rockchip/rk1808/fs-overlay-64/ board/rockchip/common/qt board/rockchip/common/firefly"
BR2_TARGET_GENERIC_HOSTNAME="rk1808"
BR2_TARGET_GENERIC_ISSUE="Welcome to RK1808 Buildroot"
BR2_PACKAGE_MULTIVIDEOPLAYER=n
BR2_PACKAGE_ROCKCHIP_TEST=y
BR2_PACKAGE_LIBPNG=n
BR2_PACKAGE_LIBPNG12=y
BR2_PACKAGE_MINIGUI=y
BR2_PACKAGE_MINIGUI_ENABLE_RGA=y
BR2_PACKAGE_MINIGUI_ENABLE_FREETYPE=y
BR2_PACKAGE_MINIGUI_ENABLE_PNG=y
BR2_PACKAGE_RKNPU=y
BR2_PACKAGE_MESA3D=y
BR2_PACKAGE_MESA3D_GALLIUM_DRIVER_SWRAST=y
BR2_PACKAGE_MESA3D_OPENGL_EGL=y
BR2_PACKAGE_MESA3D_OPENGL_ES=y
BR2_PACKAGE_LIBDRM=y
BR2_PACKAGE_ROCKX=y
# BR2_PACKAGE_QT5CONNECTIVITY is not set

# Firefly
BR2_ROOTFS_OVERLAY="board/rockchip/common/qt board/rockchip/common/firefly board/firefly/cs_r1"
BR2_TARGET_GENERIC_ROOT_PASSWD="firefly"

# ff_export_rootfs_buildroot
BR2_PACKAGE_RSYNC=y
BR2_PACKAGE_UTIL_LINUX_BINARIES=y
```

## configs/firefly_rk3588_defconfig
```kconfig
#include "base/base.config"
#include "chips/rk3588_aarch64.config"
#include "font/chinese.config"
#include "fs/exfat.config"
#include "fs/ntfs.config"
#include "fs/vfat.config"
#include "gpu/gpu.config"
#include "multimedia/audio.config"
#include "multimedia/camera.config"
#include "multimedia/gst/audio.config"
#include "multimedia/gst/camera.config"
#include "multimedia/gst/rtsp.config"
#include "multimedia/gst/video.config"
#include "multimedia/mpp.config"
#include "wifibt/bt.config"
#include "wifibt/wireless.config"
#include "benchmark.config"
#include "chromium.config"
#include "debug.config"
#include "npu2.config"
#include "powermanager.config"
#include "test.config"
#include "weston.config"

BR2_PACKAGE_RKWIFIBT_AP6275P=y
BR2_PACKAGE_RKWIFIBT_BTUART="ttyS8"

# Firefly
BR2_TARGET_GENERIC_ROOT_PASSWD="firefly"
BR2_PACKAGE_RKWIFIBT_BTUART="ttyS6"
BR2_ROOTFS_OVERLAY+="board/firefly/roc-rk3588s-pc board/firefly/itx-3588j board/firefly/aio-3588sjd4"
BR2_PACKAGE_WPA_SUPPLICANT_WPS=y
BR2_PACKAGE_WPA_SUPPLICANT_WPA3=y
BR2_PACKAGE_HOSTAPD_WPS=y
BR2_PACKAGE_HOSTAPD_WPA3=y
BR2_PACKAGE_ROCKIT=y
BR2_PACKAGE_ROCKIT_MPI=y
BR2_PACKAGE_RSYNC=y
BR2_PACKAGE_UTIL_LINUX_BINARIES=y

# can
BR2_PACKAGE_CAN_UTILS=y
BR2_PACKAGE_IPROUTE2=y
BR2_PACKAGE_LIBSOCKETCAN=y
BR2_PREFER_ROCKCHIP_RGA=y
```

## configs/rockchip_rk3399_recovery_raw_defconfig
```kconfig
#include "rk3399_arm64.config"
#include "base.config"
#include "base_extra.config"
#include "recovery.config"
#include "ntfs.config"

BR2_ROOTFS_OVERLAY="board/rockchip/common/recovery-raw board/rockchip/rk3399/fs-overlay-recovery/"
BR2_PACKAGE_GPTFDISK=y
BR2_PACKAGE_GPTFDISK_SGDISK=y
BR2_PACKAGE_PARTED=y
```

## configs/rockchip_rk356x_recovery_raw_defconfig
```kconfig
#include "base.config"
#include "base_extra.config"
#include "recovery.config"
#include "rk356x_arm64.config"
BR2_ROOTFS_OVERLAY="board/rockchip/common/recovery-raw board/rockchip/rk356x/fs-overlay-recovery/"
BR2_PACKAGE_GPTFDISK=y
BR2_PACKAGE_GPTFDISK_SGDISK=y
BR2_PACKAGE_PARTED=y
```

## package/firefly/Config.in
```kconfig
menuconfig BR2_PACKAGE_FIREFLY
	bool "Firefly packages"

if BR2_PACKAGE_FIREFLY
source "package/firefly/quectel-CM/Config.in"
source "package/firefly/iot_client/Config.in"
source "package/firefly/firefly_bridge_net/Config.in"
source "package/firefly/firefly_wifi_tool/Config.in"

endif
```
